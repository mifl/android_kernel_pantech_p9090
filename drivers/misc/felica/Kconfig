## drivers/misc/felica/Kconfig
```kconfig
#Felica devices
#
menu "Felica Device Driver"
config FELICA_DEVICES
	bool "FeliCa devices"
	default n
	---help---
	  You'll have to say Y if your computer contains an FeliCa device that
	  you want to use under Linux.

	  You can say N here if you don't have any Felica devices connected to your computer.

if FELICA_DEVICES

config CXD2235AGC_NFC_FELICA
	tristate "Sony NFC and felica driver "
	depends on SERIAL_MSM_HSL 
	default n
	---help---
	  Say yes if you want Sony CXD2235 Near Field Communication driver.
	  If unsure, say N here.

	  To compile this driver as a module, choose m here. The module will
	  be called cxd2235agc.

config S7760A
	tristate "PROGRAMJMABLE PORT CONTROLLER driver"
	depends on FELICA_DEVICES
	default n
	---help---
	 Say yes if you want S7760A driver.
	 If unsure, say N here.
	 
	 To compile this driver as a module, choose m here. The module will
	 be called s7760a
endif # NFC_DEVICES
endmenu
```

## drivers/net/wireless/bcmdhd_org/Kconfig
```kconfig
config BCMDHD
	tristate "Broadcom 4330/34 wireless cards support"
	depends on MMC && WLAN
	---help---
	  This module adds support for wireless adapters based on
	  Broadcom 4330/34 chipset.

	  This driver uses the kernel's wireless extensions subsystem.

	  If you choose to build a module, it'll be called dhd. Say M if
	  unsure.

config BCMDHD_FW_PATH
	depends on BCMDHD
	string "Firmware path"
	default "/system/vendor/firmware/fw_bcmdhd.bin"
	---help---
	  Path to the firmware file.

config BCMDHD_NVRAM_PATH
	depends on BCMDHD
	string "NVRAM path"
	default "/system/etc/nv_bcmdhd.txt"
	---help---
	  Path to the calibration file.

config BROADCOM_WIFI_RESERVED_MEM
	bool "BROADCOM Reserved memory for wifi device"
	depends on BCMDHD
	default n
	---help---
	  This is a configuration for broadcom WLAN driver.
```
